## drivers/audio/Kconfig
```kconfig
# SPDX-License-Identifier: Apache-2.0

config AUDIO_DAC_ESP32
	bool "ESP32 built-in DAC audio playback driver (I2S0 DMA)"
	default y
	depends on DT_HAS_ESPRESSIF_ESP32_DAC_AUDIO_ENABLED
	depends on AUDIO_CODEC
	depends on !ADC_ESP32_DMA
	select DAC
	help
	  Plays 16-bit mono PCM on an ESP32 DAC channel (8-bit effective).
	  I2S0 in built-in DAC mode paces the samples and its DMA feeds them,
	  so I2S0 and ADC DMA mode cannot be used at the same time.

config AUDIO_DAC_ESP32_MAX_BLOCK_SIZE
	int "ESP32 DAC audio maximum block size in bytes"
	default 512
	range 4 4092
	depends on AUDIO_DAC_ESP32
	help
	  Double buffering: RAM cost per instance is twice this value.
	  Must be a multiple of 4 (one DMA word holds two samples).
```

## dts/bindings/audio/espressif,esp32-dac-audio.yaml
```yaml
# SPDX-License-Identifier: Apache-2.0

description: |
  PCM audio playback on an ESP32 built-in DAC channel, streamed by the I2S0
  DMA in built-in DAC mode (the I2S WS clock paces the conversions).

  The referenced I2S node must stay disabled: this driver owns its registers.

compatible: "espressif,esp32-dac-audio"

include: base.yaml

properties:
  io-channels:
    type: phandle-array
    required: true
    description: DAC channel, <&dac 0> is GPIO25, <&dac 1> is GPIO26.

  espressif,i2s:
    type: phandle
    required: true
    description: I2S controller used as the DMA engine (only i2s0 can drive the DAC).
```

## west.yml
```yaml
# SPDX-License-Identifier: Apache-2.0

manifest:
  self:
    path: esp32_dac

  remotes:
    - name: zephyrproject-rtos
      url-base: https://github.com/zephyrproject-rtos

  projects:
    - name: zephyr
      remote: zephyrproject-rtos
      revision: v4.5.0
      import:
        name-allowlist:
          - hal_espressif
          - libsbc
          - mbedtls
          - tf-psa-crypto
```
