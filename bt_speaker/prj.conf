## CMakeLists.txt
```
# SPDX-License-Identifier: Apache-2.0
# Reuses Zephyr's a2dp_sink sample (GAP/SDP/A2DP + SBC decode); only the
# audio output (codec_play.c) is ours, targeting the ESP32 DAC codec.

cmake_minimum_required(VERSION 3.20.0)

find_package(Zephyr REQUIRED HINTS $ENV{ZEPHYR_BASE})
project(bt_speaker)

set(SAMPLE ${ZEPHYR_BASE}/samples/bluetooth/classic/a2dp_sink)
target_sources(app PRIVATE ${SAMPLE}/src/main.c ${SAMPLE}/src/audio_buf.c src/codec_play.c)
target_include_directories(app PRIVATE ${SAMPLE}/src)
zephyr_library_include_directories(${ZEPHYR_BASE}/samples/bluetooth)
```

## Kconfig
```
# SPDX-License-Identifier: Apache-2.0
source "$(ZEPHYR_BASE)/samples/bluetooth/classic/a2dp_sink/Kconfig"
```

## prj.conf
```kconfig
CONFIG_BT=y
CONFIG_BT_CLASSIC=y
CONFIG_BT_PERIPHERAL=y
CONFIG_BT_AVDTP=y
CONFIG_BT_A2DP=y
CONFIG_BT_A2DP_SINK=y
CONFIG_BT_DEVICE_NAME="esp32_dac"
CONFIG_BT_COD=0x200404
CONFIG_BT_BUF_ACL_RX_SIZE=1300

CONFIG_AUDIO=y
CONFIG_AUDIO_CODEC=y
# Only to pass audio_buf.c's compile gate, no I2S driver instance is enabled
CONFIG_I2S=y
# 12 x 1920 B decoded PCM (default 50 = 96 KB, too much next to the BT controller)
CONFIG_A2DP_SBC_PCM_BUFFER_PLAY_COUNT=12
CONFIG_LOG=y
CONFIG_MAIN_STACK_SIZE=4096
```

## boards/esp32_devkitc_procpu.overlay
```dts
/*
 * Copyright (c) 2026 Eve Redero
 * SPDX-License-Identifier: Apache-2.0
 *
 * DAC1 on GPIO25 -> 1 uF -> amp input (PAM8403/LM386), GND shared.
 */

/ {
	aliases {
		codec0 = &dac_audio0;
		/* ponytail: alias + CONFIG_I2S only satisfy audio_buf.c's compile gate;
		 * copy that file locally if it ever bites.
		 */
		i2s-codec-tx = &dac_audio0;
	};

	dac_audio0: dac-audio {
		compatible = "espressif,esp32-dac-audio";
		io-channels = <&dac 0>;		/* DAC_CHAN_0 = GPIO25 */
		espressif,i2s = <&i2s0>;	/* stays disabled, driver owns it */
	};
};

&dac {
	status = "okay";
};
```

## src/codec_play.c
```c
/*
 * Copyright (c) 2026 Eve Redero
 * SPDX-License-Identifier: Apache-2.0
 *
 * codec_play.h backend for the Zephyr a2dp_sink sample: decoded SBC PCM
 * (16-bit, 1 or 2 channels) -> mono ring -> ESP32 DAC audio codec.
 * The sample's main loop thread runs codec_keep_play() as the producer;
 * the DAC tx-done ISR is the consumer.
 */

#include <zephyr/kernel.h>
#include <zephyr/audio/codec.h>
#include <zephyr/sys/ring_buffer.h>
#include <zephyr/logging/log.h>
#include "audio_buf.h"
#include "codec_play.h"

LOG_MODULE_REGISTER(codec_play, LOG_LEVEL_INF);

#define BLOCK_SAMPLES 256U
#define BLOCK_BYTES   (BLOCK_SAMPLES * sizeof(int16_t))
#define CHUNK_FRAMES  480U   /* 10 ms @ 48 kHz, the largest audio_buf hands out */

static const struct device *codec_dev = DEVICE_DT_GET(DT_ALIAS(codec0));

/* ponytail: phone clock vs I2S PLL drift is absorbed by backpressure into
 * audio_buf (drops when full) and silence on underrun. Add sample slipping if
 * clicks show up every few seconds.
 */
RING_BUF_DECLARE(pcm_ring, 8192);   /* ~93 ms mono @ 44.1 kHz */

static int16_t tx_buf[BLOCK_SAMPLES];
static int16_t mono[CHUNK_FRAMES];
static uint32_t chunk_frames;
static uint8_t num_ch;
static volatile bool playing;

static void tx_done(const struct device *dev, void *user_data)
{
	ARG_UNUSED(user_data);
	uint32_t got = ring_buf_get(&pcm_ring, (uint8_t *)tx_buf, BLOCK_BYTES);

	if (got < BLOCK_BYTES) {
		memset((uint8_t *)tx_buf + got, 0, BLOCK_BYTES - got);
	}
	audio_codec_write(dev, (uint8_t *)tx_buf, BLOCK_BYTES);
}

int codec_play_init(void)
{
	if (!device_is_ready(codec_dev)) {
		LOG_ERR("codec device not ready");
		return -ENODEV;
	}
	return audio_codec_register_done_callback(codec_dev, tx_done, NULL, NULL, NULL);
}

void codec_play_configure(uint32_t sample_rate, uint8_t sample_width, uint8_t channels)
{
	struct audio_codec_cfg cfg = {
		.dai_type = AUDIO_DAI_TYPE_PCM,
		.dai_route = AUDIO_ROUTE_PLAYBACK,
		.dai_cfg.pcm = {
			.dir = AUDIO_DAI_DIR_TX,
			.pcm_width = AUDIO_PCM_WIDTH_16_BITS,
			.channels = 1,
			.block_size = BLOCK_BYTES,
			.samplerate = sample_rate,
		},
	};
	int ret;

	if (sample_width != 16 || channels == 0 || channels > 2) {
		LOG_ERR("unsupported PCM: %u bit, %u ch", sample_width, channels);
		return;
	}
	num_ch = channels;
	chunk_frames = sample_rate / 100;   /* audio_buf works in 10 ms chunks */

	ret = audio_codec_configure(codec_dev, &cfg);
	if (ret < 0) {
		LOG_ERR("audio_codec_configure failed: %d", ret);
		return;
	}
	LOG_INF("configured %u Hz, %u ch -> mono DAC", sample_rate, channels);
}

void codec_play_start(void)
{
	if (playing) {
		return;
	}
	ring_buf_reset(&pcm_ring);
	playing = true;
	audio_codec_start(codec_dev, AUDIO_DAI_DIR_TX);
}

void codec_play_stop(void)
{
	if (!playing) {
		return;
	}
	playing = false;
	audio_codec_stop(codec_dev, AUDIO_DAI_DIR_TX);
}

void codec_keep_play(void)
{
	while (true) {
		uint32_t len = chunk_frames * num_ch * sizeof(int16_t);
		uint8_t *data;

		if (!playing || ring_buf_space_get(&pcm_ring) < chunk_frames * sizeof(int16_t)) {
			k_msleep(2);
			continue;
		}

		audio_get_pcm_data(&data, len);
		if (data == NULL) {
			k_msleep(2);
			continue;
		}

		const int16_t *pcm = (const int16_t *)data;

		for (uint32_t i = 0; i < chunk_frames; i++) {
			mono[i] = (num_ch == 2) ? (int16_t)(((int32_t)pcm[2 * i] + pcm[2 * i + 1]) / 2)
						: pcm[i];
		}
		ring_buf_put(&pcm_ring, (uint8_t *)mono, chunk_frames * sizeof(int16_t));
		audio_media_sync(data, len);
	}
}
```
